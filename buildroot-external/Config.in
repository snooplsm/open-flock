## buildroot-external/Config.in
```kconfig
menu "PiCam OS packages"
    source "$BR2_EXTERNAL_PICAM_PATH/package/picam-onnxruntime/Config.in"
    source "$BR2_EXTERNAL_PICAM_PATH/package/picam-pipeline/Config.in"
    source "$BR2_EXTERNAL_PICAM_PATH/package/picam-httpd/Config.in"
endmenu
```

## buildroot-external/configs/picam_rpi4_defconfig
```kconfig
BR2_aarch64=y
BR2_cortex_a72=y
BR2_TOOLCHAIN_BUILDROOT_MUSL=y
BR2_TOOLCHAIN_BUILDROOT_CXX=y
BR2_INIT_BUSYBOX=y
BR2_SYSTEM_DHCP="eth0"
BR2_TARGET_GENERIC_HOSTNAME="picam"
BR2_TARGET_GENERIC_ISSUE="PiCam OS"
BR2_TARGET_GENERIC_GETTY=n
BR2_ROOTFS_OVERLAY="$(BR2_EXTERNAL_PICAM_PATH)/board/picam/overlay"

BR2_LINUX_KERNEL=y
BR2_KERNEL_HEADERS_AS_KERNEL=y
BR2_PACKAGE_HOST_LINUX_HEADERS_CUSTOM_6_6=y
BR2_LINUX_KERNEL_NEEDS_HOST_OPENSSL=y
BR2_LINUX_KERNEL_CUSTOM_VERSION=y
BR2_LINUX_KERNEL_CUSTOM_VERSION_VALUE="6.6.30"
BR2_LINUX_KERNEL_USE_ARCH_DEFAULT_CONFIG=y
BR2_LINUX_KERNEL_DTS_SUPPORT=y
BR2_LINUX_KERNEL_INTREE_DTS_NAME="broadcom/bcm2711-rpi-4-b"

BR2_PACKAGE_RPI_FIRMWARE=y
BR2_PACKAGE_RPI_FIRMWARE_VARIANT_PI4=y
BR2_PACKAGE_RPI_FIRMWARE_CONFIG_FILE="$(BR2_EXTERNAL_PICAM_PATH)/board/picam/config.txt"
BR2_PACKAGE_RPI_FIRMWARE_CMDLINE_FILE="$(BR2_EXTERNAL_PICAM_PATH)/board/picam/cmdline.txt"

BR2_PACKAGE_BUSYBOX_SHOW_OTHERS=y
BR2_PACKAGE_DBUS=y
BR2_PACKAGE_LIBCAMERA=y
BR2_PACKAGE_LIBCAMERA_V4L2_COMPAT=y
BR2_PACKAGE_IW=y
BR2_PACKAGE_WPA_SUPPLICANT=y
BR2_PACKAGE_WPA_SUPPLICANT_PASSPHRASE=y
BR2_PACKAGE_BLUEZ5_UTILS=y
BR2_PACKAGE_BLUEZ5_UTILS_TOOLS=y
BR2_PACKAGE_DROPBEAR=y
BR2_PACKAGE_TENSORFLOW_LITE=y

BR2_PACKAGE_PICAM_ONNXRUNTIME=y
BR2_PACKAGE_PICAM_PIPELINE=y
BR2_PACKAGE_PICAM_HTTPD=y

BR2_TARGET_ROOTFS_EXT2=y
BR2_TARGET_ROOTFS_EXT2_4=y
BR2_TARGET_ROOTFS_EXT2_SIZE="256M"
```

## buildroot-external/package/picam-httpd/Config.in
```kconfig
config BR2_PACKAGE_PICAM_HTTPD
    bool "picam-httpd"
    help
      Tiny C HTTP server that exposes /health and /latest.jpg.
```

## buildroot-external/package/picam-onnxruntime/Config.in
```kconfig
config BR2_PACKAGE_PICAM_ONNXRUNTIME
    bool "picam-onnxruntime"
    help
      ONNX Runtime C/C++ inference runtime for aarch64 targets.

      This package builds a CPU-only minimal shared library and installs
      headers + libonnxruntime into staging/target.
```

## buildroot-external/package/picam-pipeline/Config.in
```kconfig
config BR2_PACKAGE_PICAM_PIPELINE
    bool "picam-pipeline"
    help
      Minimal C camera pipeline using V4L2 MJPEG capture.
```
